## boards/shields/flexyboard/Kconfig.defconfig
```kconfig
CONFIG_CLOCK_CONTROL_NRF_K32SRC_RC=y

if SHIELD_FLEXYBOARD_LEFT

config ZMK_KEYBOARD_NAME
    default "flexyboard"

config ZMK_SPLIT_ROLE_CENTRAL
    default y

endif

if SHIELD_FLEXYBOARD_LEFT || SHIELD_FLEXYBOARD_RIGHT

config ZMK_SPLIT
    default y

endif
```

## boards/shields/flexyboard/Kconfig.shield
```kconfig
# No whitespace after the comma or in your part name!
config SHIELD_FLEXYBOARD_LEFT
    def_bool $(shields_list_contains,flexyboard_left)

# No whitespace after the comma or in your part name!
config SHIELD_FLEXYBOARD_RIGHT
    def_bool $(shields_list_contains,flexyboard_right)
```
